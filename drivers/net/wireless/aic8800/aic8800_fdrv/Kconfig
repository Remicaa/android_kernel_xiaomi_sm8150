## drivers/net/wireless/aic8800/aic8800_fdrv/Kconfig
```kconfig
config AIC8800_WLAN_SUPPORT
	tristate "AIC8800 WLAN Support"
	depends on m && USB && CFG80211 && AIC_LOADFW_SUPPORT
	help
	  This is support for AIC8800/AIC8800D80 USB Wi-Fi 6 driver with monitor
	  mode and radiotap packet injection support.
```

## drivers/net/wireless/aic8800/aic_load_fw/Kconfig
```kconfig
config AIC_LOADFW_SUPPORT
	tristate "AIC8800 Load Firmware Support"
	depends on m && USB
	help
	  This is support for AIC8800 USB firmware loader module.
```
